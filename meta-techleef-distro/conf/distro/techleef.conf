## meta-techleef-distro/conf/distro/techleef.conf
```bitbake
DISTRO_NAME = "Techleef (A Custom embedded linux distribution)"
DISTRO_VERSION = "1.0"

DISTRO_FEATURES = "sysvinit ipv4 ipv6 wifi vfat ext2 opengl wayland vulkan ldconfig"
```

## meta-techleef-distro/conf/machine/rpi4b.conf
```bitbake
#@TYPE: Machine
#@NAME: Techleef Raspberry Pi 4 (64-bit)
#@DESCRIPTION: Custom machine for Techleef Pi4 device with HDMI+SPI touchscreen

MACHINEOVERRIDES =. "rpi4:"

# Machine features tailored to your hardware
MACHINE_FEATURES = "screen touchscreen spi vfat ext2 wifi sdio vc4graphics"

# Optional Wi-Fi firmware only
MACHINE_EXTRA_RRECOMMENDS += "linux-firmware-rpidistro-bcm43455"

# CPU tuning and base settings from meta-raspberrypi
require conf/machine/include/arm/armv8a/tune-cortexa72.inc
include conf/machine/include/rpi-base.inc

# Specify the kernel defconfig - THIS IS THE KEY FIX
KBUILD_DEFCONFIG = "bcm2711_defconfig"

# Device tree for Pi4
RPI_KERNEL_DEVICETREE = "broadcom/bcm2711-rpi-4-b.dtb"
KERNEL_DEVICETREE ??= " \
    ${RPI_KERNEL_DEVICETREE} \
    ${RPI_KERNEL_DEVICETREE_OVERLAYS} \
"

# Kernel / U-Boot settings
SDIMG_KERNELIMAGE ?= "kernel8.img"
UBOOT_MACHINE = "rpi_arm64_config"
VC4DTBO ?= "vc4-kms-v3d"
KERNEL_IMAGETYPE_UBOOT ?= "Image"
KERNEL_IMAGETYPE_DIRECT ?= "Image"
KERNEL_BOOTCMD ?= "booti"
ARMSTUB ?= "armstub8-gic.bin"
```

## meta-techleef-prj/conf/layer.conf
```bitbake
# We have a conf and classes directory, add to BBPATH
BBPATH .= ":${LAYERDIR}"

# We have recipes-* directories, add to BBFILES
BBFILES += "${LAYERDIR}/recipes-*/*/*.bb \
            ${LAYERDIR}/recipes-*/*/*.bbappend"

BBFILE_COLLECTIONS += "meta-techleef-prj"
BBFILE_PATTERN_meta-techleef-prj = "^${LAYERDIR}/"
BBFILE_PRIORITY_meta-techleef-prj = "6"

LAYERDEPENDS_meta-techleef-prj = "core"
LAYERSERIES_COMPAT_meta-techleef-prj = "scarthgap"
```
